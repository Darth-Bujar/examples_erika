; --------------------------------------------------------------------------------
; @Title: Script for S32K148
; @Description:
;   Loads application into MCU internal RAM and sets up a debug scenario.

WinCLEAR

; --------------------------------------------------------------------------------
; initialize and start the debugger

RESet
SYStem.RESet
SYStem.CPU S32K148
SYStem.CONFIG.DEBUGPORTTYPE SWD
IF COMBIPROBE()||UTRACE()
(
  SYStem.CONFIG.CONNECTOR MIPI20T
)
SYStem.Option DUALPORT ON
SYStem.MemAccess DAP
SYStem.JtagClock CTCK 10MHz
Trace.DISable
SYStem.Up

; disable BootROM
GOSUB DisableBootrom
; disable Watchdog
GOSUB DisableWatchdog

; --------------------------------------------------------------------------------
; load demo program (uses internal RAM only)
Data.LOAD.Elf "~~~~/erika3app.elf"

; --------------------------------------------------------------------------------
; initialize OFFCHIP trace (ETM, ITM)
IF COMBIPROBE()||UTRACE()||Analyzer()
(
  ; set PinMux and enable Clocks
  ; enable PORTx clocks
  Data.Set AD:0x40065124 %Long Data.Long(AD:0x40065124)|0x40000000
  Data.Set AD:0x40065128 %Long Data.Long(AD:0x40065128)|0x40000000
  Data.Set AD:0x4006512C %Long Data.Long(AD:0x4006512C)|0x40000000
  Data.Set AD:0x40065130 %Long Data.Long(AD:0x40065130)|0x40000000
  Data.Set AD:0x40065134 %Long Data.Long(AD:0x40065134)|0x40000000

  ; pad configuration
  ; due to the routing on the EVB the timing is not trivial to handle
  ; for uTrace/Combiprobe reducing the drive strength of the CLK line showed good results
  ; for AutoFocus the drive strength must be high due to the termination
  PRIVATE &dsClk &dsData
  &dsClk=(0x0<<6.)  ; drive strength=LOW
  &dsData=(0x1<<6.) ; drive strength=HIGH
  ; TraceClk
  ; Data.Set AD:0x4004B008 %Long 0x00000600|&dsClk  ; PTC2
  Data.Set AD:0x4004C040 %Long 0x00000600|&dsClk    ; PTD16
  ; TraceD0
  Data.Set AD:0x4004C000 %Long 0x00000500|&dsData   ; PTD0
  ; Data.Set AD:0x4004C01C %Long 0x00000600|&dsData ; PTD7
  ; TraceD1
  ; Data.Set AD:0x4004C030 %Long 0x00000400|&dsData ; PTD12
  Data.Set AD:0x4004D010 %Long 0x00000200|&dsData   ; PTE4
  ; TraceD2
  Data.Set AD:0x4004C02C %Long 0x00000400|&dsData   ; PTD11
  ; Data.Set AD:0x4004C040 %Long 0x00000600|&dsData ; PTD16
  ; TraceD3
  ; Data.Set AD:0x4004C028 %Long 0x00000400|&dsData ; PTD10
  Data.Set AD:0x4004C03C %Long 0x00000300|&dsData   ; PTD15

  ; select TRACECLK_SEL=CORE
  Data.Set AD:0x40048004 %Long Data.Long(AD:0x40048004)&~0x1000
  ; divide trace clock = input clock
  Data.Set AD:0x40048068 %Long Data.Long(AD:0x40048068)&~0x10000000
  Data.Set AD:0x40048068 %Long 0x00000000;
  Data.Set AD:0x40048068 %Long 0x10000000;

  ; optional initialize clocks
  ; GOSUB ClockInitHSI60
  ; note does not reliable on S32K148EVB
  ; GOSUB ClockInitPll112

  TPIU.PortSize 4
  TPIU.PortMode Continuous
  ITM.DataTrace CorrelatedData
  ITM.ON
  ETM.Trace ON
  ETM.ON
)
IF COMBIPROBE()||UTRACE()
(
  Trace.METHOD CAnalyzer
  Trace.AutoInit ON
  IF VERSION.BUILD.BASE()>=74752.
  (
    CAnalyzer.AutoFocus
  )
  ELSE
  (
    ; for uTrace & Combiprobe use manual calibration
    ; CAnalyzer.ClockDELAY Large
  )
)
ELSE IF Analyzer()
(
  Trace.METHOD Analyzer
  Trace.AutoInit ON
  Trace.AutoFocus
)

; --------------------------------------------------------------------------------
; start program execution
Go.direct main
WAIT !STATE.RUN()

; --------------------------------------------------------------------------------
; open some windows
WinCLEAR
Mode.Hll
WinPOS 0. 0. 116. 26.
List.auto
WinPOS 120. 0. 100. 8.
Frame.view
WinPOS 120. 14.
Var.Watch
;Var.AddWatch %SpotLight ast flags
WinPOS 120. 25.
Trace.List
;WinPOS 0. 32.
;Var.DRAW %DEFault sinewave

ENDDO

; --------------------------------------------------------------------------------

DisableBootrom:
(
  Data.Set AD:0x4007F010 %LE %Long 0x6
  Data.Set AD:0x4007F014 %LE %Long 0x0
  RETURN
)

DisableWatchdog:
(
  LOCAL &tmp1 &tmp2
  &tmp1=Data.Long(ST:0x20000000)
  &tmp2=Data.Long(ST:0x20000004)
  Register.SWAP
  ; The watchdog has a restrictive timing. It has to be configured and unlocked within a peripod
  ; of 128 cycles. Therefor the unlock sequence need to be done by a small target program.
  Data.Assemble ST:0x20000000  str  r1,[r0]  ;SD:0x40052004 = 0xD928C520   (Key)
  Data.Assemble ,              str  r3,[r2]  ;SD:0x40052000 = 0x00002120   (Control register)
  Data.Assemble ,              str  r5,[r4]  ;SD:0x40052008 = 0x0000FFFF   (Timeout value)
  Data.Assemble ,              bkpt #0
  Register.Set PC 0x20000000
  Register.Set SP 0x20001000
  Register.Set R0 0x40052004
  Register.Set R1 0xD928C520
  Register.Set R2 0x40052000
  Register.Set R3 0x00002120
  Register.Set R4 0x40052008
  Register.Set R5 0x0000FFFF
  Go.direct
  WAIT !RUN()

  Data.Set ST:0x20000000 %Long &tmp1
  Data.Set ST:0x20000004 %Long &tmp2
  Register.SWAP

  RETURN
)

ClockInitHSI60:
(
  ; SIRCCSR.EN = 1 - enable SIRC
  Data.Set AD:0x40064200 %Long Data.Long(AD:0x40064200)|0x1
  SCREEN.WAIT (Data.Long(AD:0x40064200)&(1<<24.))!=0 1.s
  IF TIMEOUT()
  (
    PRINT %ERROR "Cannot start SIRC!"
    STOP
    ENDDO
  )
  ; switch to SIRC
  ; RCCR.SCS = SIRC
  Data.Set AD:0x40064014 %Long (Data.Long(AD:0x40064014)&~(0xf<<24.))|(0x2<<24.)
  ; VCCR.SCS = SIRC
  Data.Set AD:0x40064018 %Long (Data.Long(AD:0x40064018)&~(0xf<<24.))|(0x2<<24.)
  ; HCCR.SCS = SIRC
  Data.Set AD:0x4006401C %Long (Data.Long(AD:0x4006401C)&~(0xf<<24.))|(0x2<<24.)
  ; CLKOUTCNFG.CLOCKOUTSEL = SIRC
  Data.Set AD:0x40064020 %Long (Data.Long(AD:0x40064020)&~(0xf<<24.))|(0x2<<24.)

  WAIT (Data.Long(AD:0x40064010)&(0xf<<24.))==(0x2<<24.) 1.s
  IF TIMEOUT()
  (
    PRINT %ERROR "Cannot switch to SIRC!"
    STOP
    ENDDO
  )

  ; FIRCCSR.EN = 0 - disable FIRC
  Data.Set AD:0x40064300 %Long Data.Long(AD:0x40064300)&~0x1
  ; FIRCCFG = 60MHz
  Data.Set AD:0x40064308 %Long 0x3
  ; FIRCCSR.EN = 1 - enable FIRC
  Data.Set AD:0x40064300 %Long Data.Long(AD:0x40064300)|0x1

  SCREEN.WAIT (Data.Long(AD:0x40064300)&(1<<24.))!=0 1.s
  IF TIMEOUT()
  (
    PRINT %ERROR "Cannot start FIRC!"
    STOP
    ENDDO
  )

  ; switch to FIRC
  ; RCCR.SCS = FIRC
  Data.Set AD:0x40064014 %Long (Data.Long(AD:0x40064014)&~(0xf<<24.))|(0x3<<24.)
  ; HCCR.SCS = FIRC
  Data.Set AD:0x4006401C %Long (Data.Long(AD:0x4006401C)&~(0xf<<24.))|(0x3<<24.)
  ; CLKOUTCNFG.CLOCKOUTSEL = FIRC
  Data.Set AD:0x40064020 %Long (Data.Long(AD:0x40064020)&~(0xf<<24.))|(0x3<<24.)

  WAIT (Data.Long(AD:0x40064010)&(0xf<<24.))==(0x3<<24.) 1.s
  IF TIMEOUT()
  (
    PRINT %ERROR "Cannot switch to FIRC!"
    STOP
    ENDDO
  )

  RETURN
)

ClockInitPll112:
(
  ; SIRCCSR.EN = 1 - enable SIRC
  Data.Set AD:0x40064200 %Long Data.Long(AD:0x40064200)|0x1
  SCREEN.WAIT (Data.Long(AD:0x40064200)&(1<<24.))!=0 1.s
  IF TIMEOUT()
  (
    PRINT %ERROR "Cannot start SIRC!"
    STOP
    ENDDO
  )
  ; switch to SIRC
  ; RCCR.SCS = SIRC
  Data.Set AD:0x40064014 %Long (Data.Long(AD:0x40064014)&~(0xf<<24.))|(0x2<<24.)
  ; VCCR.SCS = SIRC
  Data.Set AD:0x40064018 %Long (Data.Long(AD:0x40064018)&~(0xf<<24.))|(0x2<<24.)
  ; HCCR.SCS = SIRC
  Data.Set AD:0x4006401C %Long (Data.Long(AD:0x4006401C)&~(0xf<<24.))|(0x2<<24.)
  ; CLKOUTCNFG.CLOCKOUTSEL = SIRC
  Data.Set AD:0x40064020 %Long (Data.Long(AD:0x40064020)&~(0xf<<24.))|(0x2<<24.)

  WAIT (Data.Long(AD:0x40064010)&(0xf<<24.))==(0x2<<24.) 1.s
  IF TIMEOUT()
  (
    PRINT %ERROR "Cannot switch to SIRC!"
    STOP
    ENDDO
  )

  ; SOSCCSR.EN = 0 - disalbe SOSC
  Data.Set AD:0x40064100 %Long Data.Long(AD:0x40064100)&~0x1
  ; SOSCCFG.Range = 8-32MHz, ERREFS=Internal
  Data.Set AD:0x40064108 %Long 0x34
  ; SOSCCSR.EN = 1 - enable SOSC
  Data.Set AD:0x40064100 %Long Data.Long(AD:0x40064100)|0x1
  SCREEN.WAIT (Data.Long(AD:0x40064100)&(1<<24.))!=0 1.s
  IF TIMEOUT()
  (
    PRINT %ERROR "Cannot start SOSC!"
    STOP
    ENDDO
  )

  ; SPLLCSR.EN = 0 - disalbe PLL
  Data.Set AD:0x40064600 %Long Data.Long(AD:0x40064600)&~0x1
  ; SPLLCFG.MULT = 224MHz/8MHz -16. = 28. - 16.
  Data.Set AD:0x40064608 %Long ((28.-16.)<<16.)
  ; SPLLCSR.EN = 1 - enable PLL
  Data.Set AD:0x40064600 %Long Data.Long(AD:0x40064600)|0x1

  SCREEN.WAIT (Data.Long(AD:0x40064600)&(1<<24.))!=0 1.s
  IF TIMEOUT()
  (
    PRINT %ERROR "Cannot start PLL!"
    STOP
    ENDDO
  )

  ; switch to PLL
  ; RCCR.SCS = PLL
  Data.Set AD:0x40064014 %Long (Data.Long(AD:0x40064014)&~(0xf<<24.))|(0x6<<24.)
  ; HCCR.SCS = PLL
  Data.Set AD:0x4006401C %Long (Data.Long(AD:0x4006401C)&~(0xf<<24.))|(0x6<<24.)
  ; CLKOUTCNFG.CLOCKOUTSEL = PLL
  Data.Set AD:0x40064020 %Long (Data.Long(AD:0x40064020)&~(0xf<<24.))|(0x6<<24.)

  WAIT (Data.Long(AD:0x40064010)&(0xf<<24.))==(0x6<<24.) 1.s
  IF TIMEOUT()
  (
    PRINT %ERROR "Cannot switch to PLL!"
    STOP
    ENDDO
  )

  RETURN
)

